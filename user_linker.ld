ENTRY(_start)
SECTIONS
{
    . = 0x800000;
    .text : ALIGN(4K)
    {
        *(.text)
    }
    .rodata : ALIGN(4K)
    {
        *(.rodata)
    }
    .data : ALIGN(4K)
    {
        *(.data)
    }
    .bss : ALIGN(4K)
    {
        *(COMMON)
        *(.bss)
    }
    /DISCARD/ :
    {
        *(.note.gnu.property)
        *(.note.GNU-stack)
        *(.eh_frame)
        *(.comment)
    }
}
